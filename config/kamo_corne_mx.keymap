// Copyright 2022 Manna Harbour
// https://github.com/manna-harbour/miryoku

#define MIRYOKU_ALPHAS_QWERTY

#include "../miryoku/custom_config.h"
#include "../miryoku/mapping/44/kamo_corne_mx.h"
#include "../miryoku/miryoku.dtsi"
